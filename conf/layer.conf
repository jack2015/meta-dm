## conf/layer.conf
```bitbake
# We have a conf and classes directory, append to BBPATH
BBPATH .= ":${LAYERDIR}"

# We have a recipes directory, add to BBFILES
BBFILES += "${LAYERDIR}/recipes-*/*.bb ${LAYERDIR}/recipes-*/*.bbappend \
            ${LAYERDIR}/recipes-*/*/*.bb ${LAYERDIR}/recipes-*/*/*.bbappend \
            ${LAYERDIR}/recipes-*/*/*/*.bb ${LAYERDIR}/recipes-*/*/*/*.bbappend"

METADM800_BASE := '${@os.path.normpath("${LAYERDIR}/../")}'
# Prevent current directory creeping into sstate objects. Otherwise, building
# in another TOPDIR will cause recipes using this variable to be rebuilt.
METADM800_BASE[vardepvalue] = 'meta-dm800'

# Additional license directories.
LICENSE_PATH += "${LAYERDIR}/conf/license"

FULL_OPTIMIZATION_dm800 = "-Os -pipe ${DEBUG_FLAGS}"
O2_OPT_dm800 = "-Os -pipe ${DEBUG_FLAGS}"
O3_OPT_dm800 = "-Os -pipe ${DEBUG_FLAGS}"
```

## conf/machine/dm500hd.conf
```bitbake
#@TYPE: Machine
#@NAME: Dreambox DM500HD
#@DESCRIPTION: Machine configuration for the Dreambox DM500HD

require conf/machine/include/dreambox-mips32el.inc
```

## conf/machine/dm520.conf
```bitbake
#@TYPE: Machine
#@NAME: Dreambox DM520
#@DESCRIPTION: Machine configuration for the Dreambox DM520

MACHINE_FEATURES += "modem kernelwifi externalwifi dvb-c blindscan-dvbc hdmicec recovery ci dvd usbconsole"

CHIPSET = "bcm73625"

require conf/machine/include/dreambox-mips32el.inc
require conf/machine/include/dreambox-mips32el-new.inc

MACHINE_EXTRA_RRECOMMENDS += "gstreamer1.0-libav"
```

## conf/machine/dm7020hd.conf
```bitbake
#@TYPE: Machine
#@NAME: Dreambox DM7020HD
#@DESCRIPTION: Machine configuration for the Dreambox DM7020HD

MACHINE_FEATURES += "modem wlan kernelwifi externalwifi dvb-c blindscan-dvbc hdmicec"
MACHINE_FEATURES += "libpassthrough ci dvd usbconsole"

MACHINE_ESSENTIAL_EXTRA_RDEPENDS += " dm-bootsplash"

require conf/machine/include/dreambox-hw-ecc.inc

DM7020NANDINC = "${@ '1024mb-2k' if d.getVar('DMTYPE') else '1024mb'}"

require conf/machine/include/dreambox-nand-${DM7020NANDINC}.inc

require conf/machine/include/dreambox-part-1024mb.inc
require conf/machine/include/dreambox-ubi.inc
require conf/machine/include/dreambox-mips32el.inc

PREFERRED_VERSION_linux-dreambox = "3.2"

CHIPSET = "bcm7405"

MACHINE_EXTRA_RRECOMMENDS += "dreambox-enigma2-config"
```

## conf/machine/dm7080.conf
```bitbake
#@TYPE: Machine
#@NAME: Dreambox DM7080
#@DESCRIPTION: Machine configuration for the Dreambox DM7080

MACHINE_FEATURES += "modem kernelwifi externalwifi dvb-c blindscan-dvbc hdmicec libpassthrough recovery ci dvd usbconsole"

CHIPSET = "bcm7435"

require conf/machine/include/dreambox-mips32el.inc
require conf/machine/include/dreambox-mips32el-new.inc
```

## conf/machine/dm800.conf
```bitbake
#@TYPE: Machine
#@NAME: Dreambox DM 800 HD PVR
#@DESCRIPTION: Machine configuration for the Dreambox DM 800 HD PVR

require conf/machine/include/dreambox-mips32el-nf.inc
```

## conf/machine/dm800se.conf
```bitbake
#@TYPE: Machine
#@NAME: Dreambox DM800se
#@DESCRIPTION: Machine configuration for the Dreambox DM800se

require conf/machine/include/dreambox-mips32el.inc

MACHINE_FEATURES += "colorlcd bwlcd96"
```

## conf/machine/dm820.conf
```bitbake
#@TYPE: Machine
#@NAME: Dreambox DM820
#@DESCRIPTION: Machine configuration for the Dreambox DM820

MACHINE_FEATURES += "modem kernelwifi externalwifi dvb-c blindscan-dvbc hdmicec libpassthrough recovery ci dvd usbconsole"

CHIPSET = "bcm7435"

require conf/machine/include/dreambox-mips32el.inc
require conf/machine/include/dreambox-mips32el-new.inc
```

## conf/machine/dm920.conf
```bitbake
#@TYPE: Machine
#@NAME: Dreambox DM920
#@DESCRIPTION: Machine configuration for the Dreambox DM920

MACHINE_FEATURES += "modem wlan kernelwifi dvb-c blindscan-dvbc hdmicec"
MACHINE_FEATURES += "libpassthrough recovery ci dvd usbconsole"
#MACHINE_FEATURES += "v3d"

CHIPSET = "bcm7252s"
SOC_FAMILY = "bcm7252s"

require conf/machine/include/dreambox-arm.inc
```

## conf/machine/include/dreambox-mips32el-nf.inc
```bitbake
# dreambox-mips32el-nf.inc

KERNELVERSION = "2.6.18"

BOX_BRAND = "dreambox"

TARGET_ARCH = "mipsel"
DEFAULTTUNE = "mips32el-nf"

MTD_KERNEL = "mtd2"

KERNEL_FILE = "kernel.bin"
ROOTFS_FILE = "rootfs.bin"

MACHINE_FEATURES_BACKFILL_CONSIDERED += "rtc"

OPTIONAL_BSP_PACKAGES += "dreambox-buildimage"
EXTRA_IMAGEDEPENDS += "dreambox-secondstage-${MACHINE}"

MACHINE_ESSENTIAL_EXTRA_RDEPENDS += "\
	dreambox-boot-progress \
	dreambox-dvb-modules-${MACHINE} \
	gstreamer1.0-plugin-dvbmediasink \
	kernel-module-autofs4 \
	kernel-module-fuse \
	kernel-module-md4 \
	v4l-dvb-module-dvb-core \
	v4l-dvb-module-stv0299 \
	"

GLIBC_EXTRA_OECONF = "--with-tls --with-__thread"
DVBMEDIASINK_CONFIG = "--with-dts=no"
OLDEST_KERNEL = "${KERNELVERSION}"
GLIBCVERSION = "2.19"

PREFERRED_VERSION_rtl8192cu = "3.3.0"
PREFERRED_VERSION_libnl = "3.2.24"
PREFERRED_VERSION_linux-dreambox = "${KERNELVERSION}"
PREFERRED_VERSION_linux-libc-headers = "${KERNELVERSION}"
PREFERRED_VERSION_wpa-supplicant = "0.5.8"
PREFERRED_VERSION_wscan = "20130331"

MACHINE_FEATURES += "alsa usbhost switchoff dreambox"

PREFERRED_PROVIDER_virtual/bootloader = "dreambox-secondstage-${MACHINE}"
PREFERRED_PROVIDER_virtual/kernel = "linux-dreambox"

PREFERRED_PROVIDER_virtual/blindscan-dvbs = "dreambox-blindscan-utils"
PREFERRED_PROVIDER_virtual/blindscan-dvbc = "dreambox-blindscan-utils"

KERNEL_IMAGETYPE = "vmlinux"
KERNEL_OUTPUT = "${KERNEL_IMAGETYPE}"
KERNEL_OUTPUT_DIR = "."
KERNEL_CONSOLE = "${@bb.utils.contains('MACHINE_FEATURES', 'usbconsole', 'ttyS0,115200', 'null', d)}"

DREAMBOX_BUILDIMAGE = "buildimage --arch ${MACHINE} ${EXTRA_BUILDCMD} \
	--erase-block-size ${DREAMBOX_ERASE_BLOCK_SIZE} \
	--flash-size ${DREAMBOX_FLASH_SIZE} \
	--sector-size ${DREAMBOX_SECTOR_SIZE}"

require conf/machine/include/tune-mips32.inc
```

## conf/machine/include/dreambox-mips32el.inc
```bitbake
# dreambox-mips32el.inc

BOX_BRAND = "dreambox"

TARGET_ARCH = "mipsel"
DEFAULTTUNE = "mips32el"

MACHINE_ESSENTIAL_EXTRA_RDEPENDS += "\
	libpagecache \
	libpassthrough \
	"

MTD_KERNEL = "mtd2"

require conf/machine/include/dreambox.inc
require conf/machine/include/tune-mips32.inc

DVBMEDIASINK_CONFIG = "--with-pcm --with-wma --with-wmv --with-dtsdownmix --with-eac3 --with-dts"
```
